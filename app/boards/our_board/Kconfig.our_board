## app/boards/our_board/board.yml
```yaml
board:
  name: our_board
  full_name: Our Board
  vendor: Iomico
  socs:
    - name: stm32g474xx
```

## twister-out/native_sim_native/host/homework.unit.ring_buf/Kconfig/arch/Kconfig
```kconfig
# Load Zephyr Arch Kconfig descriptions.
osource "/home/bindere/iomico/fundamental/deps/zephyr/arch/rx/Kconfig"
osource "/home/bindere/iomico/fundamental/deps/zephyr/arch/x86/Kconfig"
osource "/home/bindere/iomico/fundamental/deps/zephyr/arch/xtensa/Kconfig"
osource "/home/bindere/iomico/fundamental/deps/zephyr/arch/sparc/Kconfig"
osource "/home/bindere/iomico/fundamental/deps/zephyr/arch/riscv/Kconfig"
osource "/home/bindere/iomico/fundamental/deps/zephyr/arch/posix/Kconfig"
osource "/home/bindere/iomico/fundamental/deps/zephyr/arch/mips/Kconfig"
osource "/home/bindere/iomico/fundamental/deps/zephyr/arch/arm64/Kconfig"
osource "/home/bindere/iomico/fundamental/deps/zephyr/arch/arm/Kconfig"
osource "/home/bindere/iomico/fundamental/deps/zephyr/arch/arc/Kconfig"
```

## twister-out/native_sim_native/host/homework.unit.ring_buf/Kconfig/boards/Kconfig.defconfig
```kconfig
# Load Zephyr board defconfig descriptions.
osource "/home/bindere/iomico/fundamental/deps/zephyr/boards/native/native_sim/Kconfig.defconfig"
```

## twister-out/native_sim_native/host/homework.unit.ring_buf/Kconfig/boards/Kconfig.native_sim
```kconfig
# Load board Kconfig descriptions.
osource "/home/bindere/iomico/fundamental/deps/zephyr/boards/native/native_sim/Kconfig.native_sim"
```
